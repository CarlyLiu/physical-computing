//--------------coding by NUO LIU(NL)&& YIHAN WANG(YH W)------------------
//--------------Code integration by NL------------------
//--------------bno055 by NL------------------
#include <Wire.h>
#include <Adafruit_Sensor.h>
#include <Adafruit_BNO055.h>
#include <utility/imumaths.h>
//----------------R by YH W-----------------------
int val=0;
//----------------oled by YH W-----------------------
#include <SPI.h>
#include <Wire.h>
#include <Adafruit_GFX.h>
#include <Adafruit_SSD1306.h>

#define SCREEN_WIDTH 128 // OLED display width, in pixels
#define SCREEN_HEIGHT 32 // OLED display height, in pixels

#define OLED_RESET     -1 // Reset pin # (or -1 if sharing Arduino reset pin)
#define SCREEN_ADDRESS 0x3C ///< See datasheet for Address; 0x3D for 128x64, 0x3C for 128x32
Adafruit_SSD1306 display(SCREEN_WIDTH, SCREEN_HEIGHT, &Wire, OLED_RESET);
//-----------------bno055 by NL-------------------
int headingVel = 0;
uint16_t BNO055_SAMPLERATE_DELAY_MS = 10; //how often to read data from the board
uint16_t PRINT_DELAY_MS = 500; // how often to print the data
uint16_t printCount = 0; //counter to avoid printing every 10MS sample

//velocity = accel*dt (dt in seconds)
//position = 0.5*accel*dt^2
double ACCEL_VEL_TRANSITION =  (double)(BNO055_SAMPLERATE_DELAY_MS) / 1000.0;
double ACCEL_POS_TRANSITION = 0.5 * ACCEL_VEL_TRANSITION * ACCEL_VEL_TRANSITION;
double DEG_2_RAD = 0.01745329251; //trig functions require radians, BNO055 outputs degrees


/* Set the delay between fresh samples */
#define BNO055_SAMPLERATE_DELAY_MS (100)

// Check I2C device address and correct line below (by default address is 0x29 or 0x28)
//                                   id, address
Adafruit_BNO055 bno = Adafruit_BNO055(55, 0x28);

//----------------oled by YH W-----------------------
static const unsigned char PROGMEM happy[] =
{
0x00,0x00,0x00,0x00,0x00,0x00,0x00,0x00,0x00,0x00,0x00,0x00,0x00,0x00,0x00,0x00,
0x00,0x00,0x03,0xFC,0x00,0x00,0x00,0x00,0x00,0x3F,0x80,0x00,0x00,0x00,0x00,0x00,
0x00,0x00,0x0C,0x02,0x00,0x00,0x00,0x00,0x00,0xC0,0x60,0x00,0x04,0x00,0x00,0x00,
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0x00,0x00,0x00,0x00,0x00,0x00,0x00,0x00,0x00,0x00,0x00,0x00,0x00,0x00,0x00,0x00,

};

static const unsigned char PROGMEM crazy[] =
{
0x00,0x00,0x00,0x00,0x00,0x00,0x00,0x00,0x00,0x00,0x00,0x00,0x00,0x00,0x00,0x00,
0x00,0x00,0x07,0xE0,0x00,0x00,0x00,0x00,0x1F,0x00,0x00,0x00,0x00,0x00,0x00,0x00,
0x00,0x07,0xC0,0x00,0x00,0x00,0x00,0x00,0x00,0x1F,0x00,0x00,0x00,0x00,0x00,0x00,
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0x00,0x00,0x00,0x00,0x00,0x00,0x00,0x00,0x00,0x00,0x00,0x00,0x00,0x00,0x00,0x00,

};

void setup(void)
{
  Serial.begin(9600);
  Serial1.begin( 38400 );
  //--------------bno055 by NL------------------
  Serial.println("Orientation Sensor Test"); Serial.println("");

  /* Initialise the sensor */
  if(!bno.begin())
  {
    /* There was a problem detecting the BNO055 ... check your connections */
    Serial.print("Ooops, no BNO055 detected ... Check your wiring or I2C ADDR!");
    while(1);
  }

  delay(500);

  bno.setExtCrystalUse(true);
  //--------------oled by YH W------------------
  // SSD1306_SWITCHCAPVCC = generate display voltage from 3.3V internally
  if(!display.begin(SSD1306_SWITCHCAPVCC, SCREEN_ADDRESS)) {
  Serial.println(F("SSD1306 allocation failed"));
  for(;;); // Don't proceed, loop forever
  }

  // Clear the buffer
  display.clearDisplay();

  // // Draw a single pixel in white
  // display.drawPixel(10, 10, SSD1306_WHITE);

  // Show the display buffer on the screen. You MUST call display() after
  // drawing commands to make them visible on screen!
  display.display();
  delay(500);
  // display.display() is NOT necessary after every single drawing command,
  // unless that's what you want...rather, you can batch up a bunch of
  // drawing operations and then update the screen all at once by calling
  // display.display(). These examples demonstrate both approaches...

  //--------------speaker by NL------------------
  // Set volume
  Serial1.print( "p" );
  Serial1.write( 1 ); // 0 = maximum volume, 255 = minimum volume
}

/**************************************************************************/
/*
    Arduino loop function, called once 'setup' is complete (your own code
    should go here)
*/
/**************************************************************************/
void loop(void)
{
  //----------------R by YH W-----------------------
  //val = analogRead(0);         // 读取电压值0~1023
  //Serial.println(val);         // 串口查看电压值的变化
  //if (val<650)
  //{
    testdrawbitmap1();    // Draw a small bitmap image
  //--------------bno055 by NL------------------
  /* Get a new sensor event */
  sensors_event_t event;
  bno.getEvent(&event);

  unsigned long tStart = micros();
  sensors_event_t orientationData , linearAccelData;
  bno.getEvent(&orientationData, Adafruit_BNO055::VECTOR_EULER);
  //  bno.getEvent(&angVelData, Adafruit_BNO055::VECTOR_GYROSCOPE);
  bno.getEvent(&linearAccelData, Adafruit_BNO055::VECTOR_LINEARACCEL);

  /* Display the floating point data */
  Serial.print("X: ");
  Serial.print(event.orientation.x, 4);
  // velocity of sensor in the direction it's facing
  headingVel = abs(ACCEL_VEL_TRANSITION * linearAccelData.acceleration.x / cos(DEG_2_RAD * orientationData.orientation.x)*100);
  
  //--------------Logical collation output by NL------------------
  Serial.print("Speed: ");
  Serial.print(headingVel);
   Serial.print("       ");
  int n=event.orientation.x;
  if (headingVel==0.00)
  {
    if (n<=100)
    {Serial.print("Left ");
    Serial1.print( "p" );
    Serial1.write( 1 ); 
    delay(300);}
    else if (50<n&&n<=130)
    {Serial.print("Middle ");
    Serial1.print( "p" );
    Serial1.write( 2 ); 
    delay(300);}
    else if (130<n&&n<=250)
    {Serial.print("Right");
    Serial1.print( "p" );
    Serial1.write( 3 ); 
    delay(300);}
    else {
      for ( int i = 1; i <= 4; i++ ) {
        // Play file i ( 1 to 5 )
        Serial1.print( "p" );
        Serial1.write( i );
        delay( 500 );}
    }
  }
else {
  for ( int i = 1; i <= 4; i++ ) {
    // Play file i ( 1 to 5 )
    Serial1.print( "p" );
    Serial1.write( i );
    // Wait a bit
    int m = headingVel*100;
    delay( m );
}
}
  ;
  if (headingVel>5.00)
  {
  testdrawbitmap2();
  delay(3000);
  testdrawbitmap1();
  };

  /* Optional: Display calibration status */
  //displayCalStatus();

  /* Optional: Display sensor status (debug only) */
  //displaySensorStatus();

  /* New line for the next sample */
  Serial.println("");

  /* Wait the specified delay before requesting nex data */
  delay(BNO055_SAMPLERATE_DELAY_MS);

  //--------------speaker by NL------------------
  //Serial1.print( "p" );
  //Serial1.write( 1 ); 
  //delay(1000);
  //};
}
//--------------oled by YH W------------------
void testdrawbitmap1 (void) {
display.clearDisplay();

display.drawBitmap(
0,0,happy,128,32,SSD1306_WHITE);
display.display();
delay(1000);
}

void testdrawbitmap2 (void) {
display.clearDisplay();

display.drawBitmap(
0,0,crazy,128,32,SSD1306_WHITE);
display.display();
delay(1000);
}